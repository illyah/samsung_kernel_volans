## drivers/input/touchscreen/synaptics_issp/Kconfig
```kconfig
#
# Touchscreen nowplus driver configuration
#

config TOUCHSCREEN_VOLANS
	tristate "ACME : MELFAS Touchscreen support"
	depends on TOUCHSCREEN_VOLANS
	help
	  Say Y here for if you are using the touchscreen features of MCS-5000.
```

## drivers/tbml/Kconfig
```kconfig
#
# Unified Flash Device configuration
#

menu "TinyBML Support for cramfs"

config RFS_TINYBML
	bool "Using TinyBML for Cramfs"
	help
	  cramfs using flash device

config TINY_FLASH_PHYS_ADDR0
        hex "OneNAND flash Physical Location"
        depends on RFS_TINYBML 
        default "0x20000000"
        help
          This is the physical address in your flash memory the xsr will
          be linked for and stored to.  This address is dependent on your
          own flash usage.

config TINY_FLASH_PHYS_ADDR1
        hex "OneNAND flash Physical Location"
        depends on RFS_TINYBML 
        default "0x70100000"
        help
          This is the physical address in your flash memory the xsr will
          be linked for and stored to.  This address is dependent on your
          own flash usage.

config RFS_TINY_DEBUG
	bool
	depends on RFS_TINYBML
	default y

endmenu
```

## drivers/video/samsung/Kconfig
```kconfig
#
# S3C Video configuration
#

config FB_S3C
	tristate "S3C Framebuffer Support"
	select FB_CFB_FILLRECT
	select FB_CFB_COPYAREA
	select FB_CFB_IMAGEBLIT
	depends on FB && (ARCH_S3C64XX || ARCH_S5P64XX || ARCH_S5PC1XX)

	default n
	---help---
	TBA

choice
depends on FB_S3C
prompt "Select LCD Type"
default FB_S3C_LTE480WV
config FB_S3C_LTE480WV
	bool "LTE480WV/LTP700WV"
	---help---
	TBA

config FB_S3C_LTV350QV
	bool "LTV350QV"
	---help---
	TBA

config FB_S3C_LTS222QV
	bool "LTS222QV"
	---help---
	TBA

config FB_S3C_L5F30961
	bool "L5F30961T00"
	---help---
	TBA  


config FB_S3C_S6D04D1X21
	bool "S6D04D1X21"
	---help---
	TBA 
endchoice

choice
depends on FB_S3C
prompt "Select BACKLIGHT Type"
default FB_S3C_BD6086
config FB_S3C_BD6086
	bool "FB_S3C_BD6086"
	---help---
	TBA

config FB_S3C_BL_AAT1231_1
	bool "FB_S3C_BL_AAT1231_1"
	---help---
	TBA
endchoice

config FB_S3C_BPP
	tristate "Advanced options for S3C Framebuffer"
	depends on FB_S3C
	default n
	---help---
	TBA

choice
depends on FB_S3C_BPP
prompt "Select BPP(Bits Per Pixel)"
default FB_S3C_BPP_16
config FB_S3C_BPP_8
	bool "8 BPP"
	---help---
	TBA

config FB_S3C_BPP_16
	bool "16 BPP"
	---help---
	TBA

config FB_S3C_BPP_24
	bool "24 BPP(XRGB888)"
	---help---
	TBA


config FB_S3C_BPP_28
	bool "28 BPP(ARGB4888)"
	---help---
	TBA

config FB_S3C_BPP_32
	bool "32 BPP(ARGB8888)"
	---help---
	TBA
endchoice

config FB_S3C_NUM
	int "Number of Framebuffers"
	depends on FB_S3C_BPP && (ARCH_S3C64XX || ARCH_S5P64XX || ARCH_S5PC1XX)
	default "1"
	---help---
	TBA

config FB_S3C_VIRTUAL_SCREEN
	bool "Enable Virtual Screen"
	depends on FB_S3C_BPP

	default n
	---help---
	TBA

config FB_S3C_DOUBLE_BUFFERING
	bool "Enable Double Buffering"
	depends on FB_S3C_BPP

	default n
	---help---
	TBA

config FB_S3C_V2
	tristate "S3C Framebuffer version 2 support"
	select FB_CFB_FILLRECT
	select FB_CFB_COPYAREA
	select FB_CFB_IMAGEBLIT
	select FRAMEBUFFER_CONSOLE_DETECT_PRIMARY
	depends on FB && (FB_S3C != y) && (FB_S3C != m) && (ARCH_S3C64XX || ARCH_S5P64XX || ARCH_S5PC1XX)
	default n
	---help---
	  This enables support for Samsung Display Controller (FIMD)

choice
depends on FB_S3C_V2
prompt "Select LCD Type"
default FB_S3C_S6D04D1X21

config FB_S3C_V2_LTE480WV
	bool "LTE480WV"
	---help---
	TBA

config FB_S3C_V2_L5F30961
	bool "L5F30961T00"
	---help---
	TBA  


config FB_S3C_V2_S6D04D1X21
	bool "S6D04D1X21"
	---help---
	TBA 
endchoice


choice
depends on FB_S3C_V2
prompt "Select BACKLIGHT Type"
default FB_S3C_BL_AAT1231_1

config FB_S3C_V2_BD6086
	bool "FB_S3C_BD6086"
	---help---
	TBA

config FB_S3C_V2_BL_AAT1231_1
	bool "FB_S3C_BL_AAT1231_1"
	---help---
	TBA
endchoice

config FB_S3C_V2_DEBUG
        bool "S3C Framebuffer version 2 debug messages"
        depends on FB_S3C_V2

config FB_S3C_V2_DEFAULT_WINDOW
	int "Default Window (0-4)"
	depends on FB_S3C_V2
	default "1"
	---help---
	  This indicates the default window number, and which is used as console framebuffer

config FB_S3C_V2_YPANSTEP
	int "Vertical Panning Step (0-2)"
	depends on FB_S3C_V2
	default "1"
	---help---
	  This indicates the number of vertical steps for pan display, 0 means no pan display and
	  1 means the double size of video buffer will be allocated for default window
```
